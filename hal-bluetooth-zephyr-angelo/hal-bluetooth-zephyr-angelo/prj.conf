## CMakeLists.txt
```
# CMakeLists.txt - Aplicação Zephyr HAL + Bluetooth

cmake_minimum_required(VERSION 3.20.0)

find_package(Zephyr REQUIRED HINTS $ENV{ZEPHYR_BASE})
project(hal_bluetooth_zephyr)

target_include_directories(app PRIVATE include)

target_sources(app PRIVATE
    src/main.c
    src/hal_gpio.c
    src/hal_bt.c
)
```

## prj.conf
```kconfig
# prj.conf - Configurações do projeto HAL + Bluetooth

# Console / debug
CONFIG_CONSOLE=y
CONFIG_SERIAL=y
CONFIG_PRINTK=y
CONFIG_STDOUT_CONSOLE=y

# GPIO
CONFIG_GPIO=y

# Thread principal cooperativa simples
CONFIG_MAIN_STACK_SIZE=2048

# Bluetooth (pode ser desativado se estiver usando uma placa sem suporte BLE)
CONFIG_BT=y
CONFIG_BT_PERIPHERAL=y
CONFIG_BT_DEVICE_NAME="HAL-BT-ANGELO"
CONFIG_BT_DEVICE_APPEARANCE=833
CONFIG_BT_MAX_CONN=1
CONFIG_BT_MAX_PAIRED=1

# GATT básico
CONFIG_BT_GATT_CLIENT=n
```

## src/main.c
```c
/*
 * main.c - Aplicação principal usando o HAL (GPIO + Bluetooth)
 */

#include <zephyr/kernel.h>
#include <zephyr/sys/printk.h>

#include "hal_gpio.h"
#include "hal_bt.h"

#define MAIN_SLEEP_MS 500

void main(void)
{
    int ret;

    printk("HAL Bluetooth + Zephyr - Angelo Lovatto\n");

    /* Inicializa camada de GPIO (LED) */
    ret = hal_gpio_init();
    if (ret) {
        printk("Erro ao inicializar HAL GPIO (%d)\n", ret);
    }

#if defined(CONFIG_BT)
    /* Tenta inicializar BLE via HAL */
    ret = hal_bt_init();
    if (ret) {
        printk("Erro ao inicializar HAL Bluetooth (%d)\n", ret);
    } else {
        printk("Bluetooth inicializado, iniciando advertising...\n");
        (void)hal_bt_start_advertising();
    }
#else
    printk("Bluetooth desabilitado em tempo de compilacao (CONFIG_BT=n)\n");
#endif

    while (1) {
        hal_gpio_led_toggle();
        k_msleep(MAIN_SLEEP_MS);
    }
}
```

## include/hal_bt.h
```c
/*
 * hal_bt.h - Interface da camada de abstração de Bluetooth
 */

#ifndef HAL_BT_H_
#define HAL_BT_H_

/* Inicializa a stack Bluetooth (quando CONFIG_BT=y).
 * Retorna 0 em caso de sucesso ou um código de erro negativo.
 */
int hal_bt_init(void);

/* Inicia advertising BLE usando o nome definido em CONFIG_BT_DEVICE_NAME.
 * Retorna 0 em caso de sucesso ou um código de erro negativo.
 */
int hal_bt_start_advertising(void);

#endif /* HAL_BT_H_ */
```

## include/hal_gpio.h
```c
/*
 * hal_gpio.h - Interface da camada de abstração de GPIO
 */

#ifndef HAL_GPIO_H_
#define HAL_GPIO_H_

#include <zephyr/kernel.h>

int hal_gpio_init(void);
void hal_gpio_led_on(void);
void hal_gpio_led_off(void);
void hal_gpio_led_toggle(void);

#endif /* HAL_GPIO_H_ */
```

## src/hal_bt.c
```c
/*
 * hal_bt.c - Implementação da camada de Bluetooth (esqueleto)
 */

#include "hal_bt.h"

#include <zephyr/sys/printk.h>
#include <errno.h>

#if defined(CONFIG_BT)

#include <zephyr/bluetooth/bluetooth.h>
#include <zephyr/bluetooth/hci.h>
#include <zephyr/sys/util.h>

static const struct bt_data ad[] = {
    BT_DATA_BYTES(BT_DATA_FLAGS, (BT_LE_AD_GENERAL | BT_LE_AD_NO_BREDR)),
    BT_DATA(BT_DATA_NAME_COMPLETE,
            CONFIG_BT_DEVICE_NAME,
            sizeof(CONFIG_BT_DEVICE_NAME) - 1),
};

static void bt_ready(int err)
{
    if (err) {
        printk("HAL BT: bt_enable falhou (err %d)\n", err);
        return;
    }
    printk("HAL BT: stack Bluetooth pronta.\n");
}

int hal_bt_init(void)
{
    int err = bt_enable(bt_ready);
    if (err) {
        printk("HAL BT: bt_enable retornou erro %d\n", err);
        return err;
    }
    return 0;
}

int hal_bt_start_advertising(void)
{
    int err = bt_le_adv_start(BT_LE_ADV_CONN_NAME, ad, ARRAY_SIZE(ad), NULL, 0);
    if (err) {
        printk("HAL BT: falha ao iniciar advertising (err %d)\n", err);
        return err;
    }

    printk("HAL BT: advertising iniciado com sucesso.\n");
    return 0;
}

#else /* CONFIG_BT não definido */

int hal_bt_init(void)
{
    printk("HAL BT: CONFIG_BT desabilitado, ignorando inicializacao.\n");
    return -ENOTSUP;
}

int hal_bt_start_advertising(void)
{
    printk("HAL BT: CONFIG_BT desabilitado, nao e possivel anunciar.\n");
    return -ENOTSUP;
}

#endif
```

## src/hal_gpio.c
```c
/*
 * hal_gpio.c - Implementação da camada de GPIO
 */

#include "hal_gpio.h"

#include <zephyr/device.h>
#include <zephyr/devicetree.h>
#include <zephyr/drivers/gpio.h>
#include <zephyr/sys/printk.h>

/* Usa o alias 'led0' definido no device tree da placa */
#if !DT_NODE_HAS_STATUS(DT_ALIAS(led0), okay)
#error "Alias 'led0' nao definido no device tree. Verifique a placa ou crie um alias."
#endif

static const struct gpio_dt_spec led0 = GPIO_DT_SPEC_GET(DT_ALIAS(led0), gpios);
static bool led_ready;
static bool led_state;

int hal_gpio_init(void)
{
    if (!device_is_ready(led0.port)) {
        printk("HAL GPIO: dispositivo do LED nao esta pronto.\n");
        led_ready = false;
        return -ENODEV;
    }

    int ret = gpio_pin_configure_dt(&led0, GPIO_OUTPUT_INACTIVE);
    if (ret < 0) {
        printk("HAL GPIO: erro ao configurar LED (%d).\n", ret);
        led_ready = false;
        return ret;
    }

    led_ready = true;
    led_state = false;
    printk("HAL GPIO: LED inicializado com sucesso.\n");
    return 0;
}

void hal_gpio_led_on(void)
{
    if (!led_ready) {
        return;
    }
    gpio_pin_set_dt(&led0, 1);
    led_state = true;
}

void hal_gpio_led_off(void)
{
    if (!led_ready) {
        return;
    }
    gpio_pin_set_dt(&led0, 0);
    led_state = false;
}

void hal_gpio_led_toggle(void)
{
    if (!led_ready) {
        return;
    }
    led_state = !led_state;
    gpio_pin_set_dt(&led0, (int)led_state);
}
```
